## sdkconfig.defaults
```kconfig
# ESP-IDF SDKの基本設定
CONFIG_ESPTOOLPY_FLASHSIZE_4MB=y
CONFIG_ESPTOOLPY_FLASHMODE_DIO=y
CONFIG_ESPTOOLPY_FLASHFREQ_40M=y

# ログレベル設定
CONFIG_LOG_DEFAULT_LEVEL_INFO=y

# FreeRTOS設定
CONFIG_FREERTOS_HZ=1000
```
